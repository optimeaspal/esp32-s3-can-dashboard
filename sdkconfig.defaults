## sdkconfig.defaults
```kconfig
# Board: Waveshare ESP32-S3-Touch-LCD-7
# Generiert aus: documents/_demo_extract/ESP32-S3-Touch-LCD-7-Demo/ESP-IDF/08_lvgl_Porting/sdkconfig.defaults

CONFIG_IDF_TARGET="esp32s3"

# CPU & Takt
CONFIG_ESP_DEFAULT_CPU_FREQ_MHZ_240=y

# Flash: 8 MB, QIO, 80 MHz
CONFIG_ESPTOOLPY_FLASHMODE_QIO=y
CONFIG_ESPTOOLPY_FLASHFREQ_80M=y
CONFIG_ESPTOOLPY_FLASHSIZE_8MB=y

# PSRAM: 8 MB Octal, 80 MHz
CONFIG_SPIRAM=y
CONFIG_SPIRAM_MODE_OCT=y
CONFIG_SPIRAM_RODATA=y
CONFIG_SPIRAM_SPEED_80M=y

# FreeRTOS: 1 kHz Tick (wichtig für LVGL-Timing)
CONFIG_FREERTOS_HZ=1000

# Cache-Alignment für RGB-DMA
CONFIG_ESP32S3_DATA_CACHE_LINE_64B=y

# LVGL: Anti-Tearing auf Core 1 (Display-Task)
CONFIG_EXAMPLE_LVGL_PORT_TASK_CORE=1
CONFIG_EXAMPLE_LVGL_PORT_AVOID_TEAR_ENABLE=y

# LVGL Speicher & Logging
CONFIG_LV_COLOR_SCREEN_TRANSP=y
CONFIG_LV_MEM_CUSTOM=y
CONFIG_LV_MEMCPY_MEMSET_STD=y
CONFIG_LV_USE_LOG=y
CONFIG_LV_LOG_PRINTF=y
CONFIG_LV_USE_PERF_MONITOR=y
CONFIG_LV_ATTRIBUTE_FAST_MEM_USE_IRAM=y

# LVGL Schriften (Montserrat für Dashboard-Labels)
CONFIG_LV_FONT_MONTSERRAT_12=y
CONFIG_LV_FONT_MONTSERRAT_16=y
CONFIG_LV_FONT_MONTSERRAT_20=y
CONFIG_LV_FONT_MONTSERRAT_24=y
CONFIG_LV_USE_FONT_COMPRESSED=y
CONFIG_LV_USE_IMGFONT=y

# LVGL Widgets (für Dashboard: Meter, Chart, Bar, LED)
CONFIG_LV_USE_DEMO_WIDGETS=y
CONFIG_LV_USE_DEMO_BENCHMARK=y

# Log: keine ANSI-Farbcodes (VS Code Output-Panel unterstützt kein ANSI)
CONFIG_LOG_COLORS=n

# WLAN: RX/TX-Buffer und LWIP ins PSRAM auslagern. Der RGB-LCD-Framebuffer +
# LVGL belegen fast den gesamten internen DMA-RAM, sodass esp_wifi_init() sonst
# mit ESP_ERR_NO_MEM abbricht ("Expected to init 10 rx buffer, actual is 0").
CONFIG_SPIRAM_TRY_ALLOCATE_WIFI_LWIP=y

# Interner RAM ist mit RGB-LCD + LVGL extrem knapp (~10 KB frei). Daher kleine
# Allokationen (>4 KB) und große statische .bss-Puffer (z.B. der 16-KB-Upload-
# Puffer im Web-Server) ins PSRAM auslagern. Ohne das schlägt das Anlegen des
# 8-KB-HTTPD-Task-Stacks fehl (ESP_ERR_HTTPD_TASK).
CONFIG_SPIRAM_MALLOC_ALWAYSINTERNAL=4096
CONFIG_SPIRAM_ALLOW_BSS_SEG_EXTERNAL_MEMORY=y

# FATFS: Long Filenames aktivieren (Default ist 8.3 → "dashboard.json" mit
# 9-Zeichen-Namen wäre sonst nicht auffindbar). LFN-Puffer im Heap, nicht auf
# dem Stack, da der Mount-Task einen begrenzten Stack hat.
CONFIG_FATFS_LFN_HEAP=y
CONFIG_FATFS_MAX_LFN=255
```

## src/Kconfig.projbuild
```kconfig
menu "CAN Dashboard Configuration"

    menu "Display / LVGL"
        config EXAMPLE_LCD_RGB_BOUNCE_BUFFER_HEIGHT
            int "RGB Bounce-Buffer Höhe"
            default 10

        config EXAMPLE_LVGL_PORT_TASK_MAX_DELAY_MS
            int "LVGL Task maximale Verzögerung (ms)"
            default 500
            range 2 2000

        config EXAMPLE_LVGL_PORT_TASK_MIN_DELAY_MS
            int "LVGL Task minimale Verzögerung (ms)"
            default 10
            range 1 100

        config EXAMPLE_LVGL_PORT_TASK_PRIORITY
            int "LVGL Task Priorität"
            default 2

        config EXAMPLE_LVGL_PORT_TASK_STACK_SIZE_KB
            int "LVGL Task Stack (KB)"
            default 6

        config EXAMPLE_LVGL_PORT_TASK_CORE
            int "LVGL Task Core (-1 = beliebig)"
            default 1
            range -1 1

        config EXAMPLE_LVGL_PORT_TICK
            int "LVGL Tick Periode (ms)"
            default 2
            range 1 100

        config EXAMPLE_LVGL_PORT_AVOID_TEAR_ENABLE
            bool "Anti-Tearing aktivieren (empfohlen für RGB-LCD)"
            default y

        choice
            depends on EXAMPLE_LVGL_PORT_AVOID_TEAR_ENABLE
            prompt "Anti-Tearing Modus"
            default EXAMPLE_LVGL_PORT_AVOID_TEAR_MODE_3
            config EXAMPLE_LVGL_PORT_AVOID_TEAR_MODE_1
                bool "Modus 1: Double-Buffer & Full-Refresh"
            config EXAMPLE_LVGL_PORT_AVOID_TEAR_MODE_2
                bool "Modus 2: Triple-Buffer & Full-Refresh"
            config EXAMPLE_LVGL_PORT_AVOID_TEAR_MODE_3
                bool "Modus 3: Double-Buffer & Direct-Mode (empfohlen)"
        endchoice

        config EXAMPLE_LVGL_PORT_AVOID_TEAR_MODE
            depends on EXAMPLE_LVGL_PORT_AVOID_TEAR_ENABLE
            int
            default 1 if EXAMPLE_LVGL_PORT_AVOID_TEAR_MODE_1
            default 2 if EXAMPLE_LVGL_PORT_AVOID_TEAR_MODE_2
            default 3 if EXAMPLE_LVGL_PORT_AVOID_TEAR_MODE_3

        config EXAMPLE_LVGL_PORT_ROTATION_DEGREE
            int
            default 0

        config EXAMPLE_LVGL_PORT_BUF_PSRAM
            bool
            default n

        config EXAMPLE_LVGL_PORT_BUF_INTERNAL
            bool
            default y

        config EXAMPLE_LVGL_PORT_BUF_HEIGHT
            int "LVGL Buffer Höhe (ohne Anti-Tearing)"
            default 100
    endmenu

    menu "CAN / TWAI"
        config EXAMPLE_TX_GPIO_NUM
            int "CAN TX GPIO"
            default 20

        config EXAMPLE_RX_GPIO_NUM
            int "CAN RX GPIO"
            default 19

        config CAN_BITRATE_KBPS
            int "CAN Bitrate (kBit/s)"
            default 500
            help
                Unterstützt: 25, 50, 100, 125, 250, 500, 800, 1000

        config CAN_RX_QUEUE_LEN
            int "CAN Empfangs-Queue Länge (Frames)"
            default 32

        config CAN_SIGNAL_STALE_MS
            int "Signal Timeout – Stale-Erkennung (ms)"
            default 2000
            help
                Widgets werden ausgegraut wenn kein Update innerhalb dieser Zeit.

        config CAN_SIMULATOR_ENABLE
            bool "CAN-Simulator aktivieren (synthetische Werte statt TWAI)"
            default y
            help
                Wenn aktiv, erzeugt der Simulator Werte für alle Signale mit
                "simulated": true in der dashboard.json – kein CAN-Bus nötig.
    endmenu

    menu "SD-Karte / Konfiguration"
        config SD_SPI_MOSI_GPIO
            int "SD SPI MOSI GPIO"
            default 11

        config SD_SPI_MISO_GPIO
            int "SD SPI MISO GPIO"
            default 13

        config SD_SPI_CLK_GPIO
            int "SD SPI CLK GPIO"
            default 12

        config SD_CS_CH422G_PIN
            int "SD Chip-Select Pin am CH422G IO-Expander"
            default 4
            help
                SD-CS wird nicht über einen direkten GPIO, sondern über den
                CH422G-IO-Expander gesteuert. Pin-Nummer am CH422G (siehe research.md).

        config DASHBOARD_JSON_PATH
            string "Pfad zur Dashboard-Konfigurationsdatei auf der SD-Karte"
            default "/sdcard/dashboard.json"
    endmenu

endmenu
```
